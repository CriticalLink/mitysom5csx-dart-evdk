## meta-mitysom-5csx-vdk/conf/layer.conf
```bitbake
# We have a conf and classes directory, append to BBPATH
BBPATH := "${LAYERDIR}:${BBPATH}"

# We have a recipes directory, add to BBFILES
BBFILES += "${LAYERDIR}/recipes*/*/*.bb ${LAYERDIR}/recipes*/*/*.bbappend"

BBFILE_COLLECTIONS += "mitysom-5csx-vdk"
BBFILE_PATTERN_mitysom-5csx-vdk := "^${LAYERDIR}/"
BBFILE_PRIORITY_mitysom-5csx-vdk = "10"
```

## meta-mitysom-5csx-vdk/conf/machine/mitysom-5csx-vdk.conf
```bitbake
#@TYPE: Machine
#@NAME: mitysom-5csx-vdk
#@DESCRIPTION: Machine configuration for MitySOM-5CSX Vision Development Kit

MACHINE_FEATURES = "serial rtc"
DISTRO_FEATURES = " ${DISTRO_FEATURES_LIBC}"
DEFAULTTUNE = "cortexa9hf-neon"

require conf/machine/include/tune-cortexa9.inc

KMACHINE = "socfpga_cyclone5"
KERNEL_IMAGETYPE ?= "uImage"
SERIAL_CONSOLE = "115200 ttyS0"
UBOOT_ENTRYPOINT = "0x00008000" 
KERNEL_EXTRA_ARGS += "LOADADDR=${UBOOT_ENTRYPOINT}"
KERNEL_DEVICETREE = "socfpga_mitysom5csx_vdk.dtb"
KBUILD_DEFCONFIG = "mitysom5csx_devkit_defconfig"

IMAGE_FSTYPES ?= "tar.gz "

PREFERRED_PROVIDER_virtual/kernel = "linux-mitysom-5csx"
PREFERRED_PROVIDER_linux = "linux-mitysom-5csx"
PREFERRED_PROVIDER_linux-libc-headers = "linux-libc-headers-mitysom-5csx"
PREFERRED_PROVIDER_linux-libc-headers-dev = "linux-libc-headers-mitysom-5csx"
```
